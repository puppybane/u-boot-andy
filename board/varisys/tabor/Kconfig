## board/varisys/tabor/Kconfig
```kconfig
if TARGET_TABOR

config SYS_BOARD
	default "tabor"

config SYS_VENDOR
	default "varisys"

config SYS_CONFIG_NAME
	default "Tabor"

endif
```

## configs/CYRUS_defconfig
```kconfig
CONFIG_PPC=y
CONFIG_MPC85xx=y
CONFIG_TARGET_CYRUS=y
CONFIG_SYS_EXTRA_OPTIONS="RAMBOOT_PBL,SYS_TEXT_BASE=0xFFF80000"
CONFIG_NETDEVICES=y
CONFIG_E1000=y
```

## configs/CYRUS_v2_defconfig
```kconfig
CONFIG_PPC=y
CONFIG_MPC85xx=y
CONFIG_TARGET_CYRUS=y
CONFIG_SYS_EXTRA_OPTIONS="RAMBOOT_PBL,SYS_TEXT_BASE=0xFFF40000,PPC_P5020,CYRUS_V2"
# CONFIG_CMD_IMLS is not set
# CONFIG_CMD_FLASH is not set
CONFIG_NETDEVICES=y
CONFIG_E1000=y
```

## configs/Cyrus_P5040_defconfig
```kconfig
CONFIG_PPC=y
CONFIG_MPC85xx=y
CONFIG_TARGET_CYRUS=y
CONFIG_SYS_EXTRA_OPTIONS="RAMBOOT_PBL,SYS_TEXT_BASE=0xFFF40000,PPC_P5040"
CONFIG_NETDEVICES=y
CONFIG_E1000=y
```

## configs/TABOR_defconfig
```kconfig
CONFIG_PPC=y
CONFIG_MPC85xx=y
CONFIG_TARGET_TABOR=y
CONFIG_SYS_EXTRA_OPTIONS="36BIT,SDCARD"
CONFIG_NETDEVICES=y
CONFIG_E1000=y
```
